## poky/meta-custom/conf/layer.conf
```bitbake
# We are a layer
BBPATH .= ":${LAYERDIR}"

BBFILE_COLLECTIONS += "custom"
BBFILE_PATTERN_custom = "^${LAYERDIR}/"
BBFILE_PRIORITY_custom = "10"

# Add your Yocto version (very important)
LAYERSERIES_COMPAT_custom = "kirkstone scarthgap nanbield styhead"

# Add your recipes if any
BBFILES += "${LAYERDIR}/recipes-*/*/*.bb ${LAYERDIR}/recipes-*/*/*.bbappend"
```
